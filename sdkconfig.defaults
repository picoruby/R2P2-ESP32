## sdkconfig.defaults
```kconfig
CONFIG_ESPTOOLPY_FLASHSIZE_4MB=y
CONFIG_PARTITION_TABLE_CUSTOM=y
CONFIG_PARTITION_TABLE_CUSTOM_FILENAME="partitions.csv"
CONFIG_FATFS_LFN_HEAP=y
CONFIG_MBEDTLS_CMAC_C=y
MBEDTLS_SSL_IN_CONTENT_LEN=8192
MBEDTLS_SSL_OUT_CONTENT_LEN=4096
```
